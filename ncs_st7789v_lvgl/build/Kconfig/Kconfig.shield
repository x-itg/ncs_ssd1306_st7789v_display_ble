## ncs_st7789v_lvgl/build/Kconfig/Kconfig.shield
```kconfig
osource "c:/ncs/apps/lvgl/boards/shields/*/Kconfig.shield"
osource "C:/ncs/v2.5.1.0/nrf/boards/shields/*/Kconfig.shield"
```

## ncs_st7789v_lvgl/build/Kconfig/Kconfig.shield.defconfig
```kconfig
osource "c:/ncs/apps/lvgl/boards/shields/*/Kconfig.defconfig"
osource "C:/ncs/v2.5.1.0/nrf/boards/shields/*/Kconfig.defconfig"
```
